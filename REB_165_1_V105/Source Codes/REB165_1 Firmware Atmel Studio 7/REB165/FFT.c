/*
 * FFT.c
 *
 * Created: 11.04.2013 22:54:50
 *  Author: Sebastian Weidmann www.weidmann-elektronik.de
 */ 

#include <math.h>
#include <avr/pgmspace.h>

#define FIX_MPY(A,B)       ( ( (A) * (B) ) >>15 )
#define LOG2_N_MAX   (10)
#define N_MAX   (1<<LOG2_N_MAX)   /* maximum number of FFT points */


const PROGMEM int32_t Sinewave[N_MAX]  ={
	0L,    201L,    402L,    603L,    804L,   1005L,   1206L,   1406L,
	1607L,   1808L,   2009L,   2209L,   2410L,   2610L,   2811L,   3011L,
	3211L,   3411L,   3611L,   3811L,   4011L,   4210L,   4409L,   4608L,
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	-1607L,  -1406L,  -1206L,  -1005L,   -804L,   -603L,   -402L,   -201L,
};



void FFT(int32_t fr[], int32_t fi[], int32_t m)
{
   int32_t mr,nn,i,j,l,k,istep, n;
   int32_t qr,qi,tr,ti,wr,wi;

   n = 1<<m;
   mr = 0;
   nn = n - 1;

   /* decimation in time - re-order data */
   for (m=1; m<=nn; ++m) {
      l = n;
      do {
         l >>= 1;
      } while(mr+l > nn);
      mr = (mr & (l-1)) + l;

      if (mr <= m) continue;
      tr = fr[m];
      fr[m] = fr[mr];
      fr[mr] = tr;
      ti = fi[m];
      fi[m] = fi[mr];
      fi[mr] = ti;
   }

   l = 1;
   k = LOG2_N_MAX-1;
   while(l < n) {

      /* it may not be obvious, but the shift will be performed
         on each data point exactly once, during this pass. */
      istep = l << 1;
      for (m=0; m<l; ++m) {
         j = m << k;
         /* 0 <= j < N_MAX/2 */
         
		 wr = pgm_read_dword(Sinewave +(j+N_MAX/4));
		 wi = -pgm_read_dword(Sinewave +j);
		 
         wr >>= 1;
         wi >>= 1;

         for (i=m; i<n; i+=istep) {
            j = i + l;
            tr = (int32_t)FIX_MPY(wr,fr[j]) - (int32_t)FIX_MPY(wi,fi[j]);
            ti = (int32_t)FIX_MPY(wr,fi[j]) + (int32_t)FIX_MPY(wi,fr[j]);
            qr = fr[i];
            qi = fi[i];
            qr >>= 1;
            qi >>= 1;

            fr[j] = qr - tr;
            fi[j] = qi - ti;
            fr[i] = qr + tr;
            fi[i] = qi + ti;
         }
      }
      --k;
      l = istep;
   }
} /* end of FixFFT() */